#include "packet_manager.h"
#include "crypto.h"
#include "esp_log.h"
#include "esp_task_wdt.h"
#include "freertos/FreeRTOS.h"
#include "freertos/queue.h"
#include "freertos/task.h"
#include "ota_button.h"
#include <string.h>


#define TAG "PKT_MGR"
#define PROCESSOR_TASK_STACK 5120
#define PROCESSOR_TASK_PRIO 5
#define QUEUE_LEN 16

static QueueHandle_t pkt_queue = NULL;
static packet_handler_t handlers[256];

// lookup table for CRC-8/GSM-A with 0x1D poly calculation
const uint8_t CRC8_0x1D_LOOKUP_TABLE[] = {
    0x00, 0x1D, 0x3A, 0x27, 0x74, 0x69, 0x4E, 0x53, 0xE8, 0xF5, 0xD2, 0xCF,
    0x9C, 0x81, 0xA6, 0xBB, 0xCD, 0xD0, 0xF7, 0xEA, 0xB9, 0xA4, 0x83, 0x9E,
    0x25, 0x38, 0x1F, 0x02, 0x51, 0x4C, 0x6B, 0x76, 0x87, 0x9A, 0xBD, 0xA0,
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    0xE3, 0xFE, 0xD9, 0xC4,
};

#define INITIAL_VALUE 0xFF
#define FINAL_XOR 0xFF

//CRC-8/SAE-J1850
uint8_t crc8(uint8_t *data, uint16_t len) {
  uint8_t crc = INITIAL_VALUE; // initial value
  uint8_t index = 0;
  int i;

  for (i = 0; i < len; i++) {
    index = crc ^ data[i]; // calculate the index to search in table
    crc = CRC8_0x1D_LOOKUP_TABLE[index]; // get the crc value for the table
  }

  return crc ^ FINAL_XOR; // do the final xor and return the crc value
}

static void packet_processor_task(void *arg) {
  packet_t pkt;

  // Subscribe this task to the Task Watchdog Timer
  esp_task_wdt_add(NULL);

  for (;;) {
    // Feed watchdog every iteration
    esp_task_wdt_reset();

    if (xQueueReceive(pkt_queue, &pkt, pdMS_TO_TICKS(10000)) == pdTRUE) {
      // Discard packets while OTA/flash-format is in progress
      if (ota_button_leds_busy()) {
        ESP_LOGW(TAG, "OTA in progress, discarding packet type 0x%02X",
                 pkt.packet_type);
        vPortFree(pkt.data);
        continue;
      }

      {
        uint8_t type = pkt.packet_type;
        if (handlers[type]) {
          handlers[type](&pkt);
        } else {
          handlers[PKT_TYPE_CLOUD](&pkt);
          ESP_LOGI(TAG, "Using default handler for type 0x%02X", type);
        }
      }
      // free buffer ownership
      vPortFree(pkt.data);
    }
  }
}

void packet_manager_init(void) {
  if (pkt_queue)
    return;
  pkt_queue = xQueueCreate(QUEUE_LEN, sizeof(packet_t));
  memset(handlers, 0, sizeof(handlers));
  if (xTaskCreate(packet_processor_task, "pkt_proc", PROCESSOR_TASK_STACK, NULL,
                  PROCESSOR_TASK_PRIO, NULL) != pdPASS) {
    ESP_LOGE(TAG, "Failed to create pkt_proc task - packet pipeline is DOWN");
    return;
  }
  ESP_LOGI(TAG, "Packet manager initialized");
}

bool packet_manager_submit(packet_t *pkt, TickType_t ticks_to_wait) {
  if (!pkt_queue) {
    ESP_LOGW(
        TAG,
        "Submit failed: queue not initialized (packet type 0x%02X dropped)",
        pkt->packet_type);
    return false;
  }
  // queue a copy of the descriptor (pointer ownership transferred)
  if (xQueueSend(pkt_queue, pkt, ticks_to_wait) != pdTRUE) {
    ESP_LOGW(TAG, "Submit failed: queue full (packet type 0x%02X dropped)",
             pkt->packet_type);
    return false;
  }
  return true;
}

bool packet_manager_submit_packet(packet_source_t source, uint8_t *data,
                                  int length, uint8_t packet_type,
                                  TickType_t ticks_to_wait) {
  uint8_t *heap_buf = pvPortMalloc(length);
  if (!heap_buf)
    return false;
  memcpy(heap_buf, data, length);
  packet_t pkt = {.source = source,
                  .data = heap_buf,
                  .length = length,
                  .packet_type = packet_type};
  if (!packet_manager_submit(&pkt, ticks_to_wait)) {
    vPortFree(heap_buf);
    return false;
  }
  return true;
}

void packet_manager_register_handler(uint8_t packet_type,
                                     packet_handler_t handler) {
  handlers[packet_type] = handler;
}